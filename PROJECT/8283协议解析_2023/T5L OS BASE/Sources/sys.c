/******************************************************************************
* 文 件 名   : sys.c
* 版 本 号   : V1.0
* 作    者   : pinot
* 生成日期   : 2019年11月01日
* 功能描述   : 初始化T5L ASIC 的寄存器
* 修改历史   :
* 日    期   :
* 作    者   :
* 修改内容   :
******************************************************************************/

/*****************************************************************************
自定义头文件*/
#include "sys.h"
#include "uart.h"
#include "timer.h"
/*****************************************************************************
全局变量*/


/*****************************************************************************
延时us*//*振荡周期T=1/206438400*/
//void DelayUs(uint16_t n)
//{
//  uint16_t i,j;
//  for(i=0;i<n;i++)
//    for(j=0;j<15;j++);
//}
/*****************************************************************************
延时ms*/
void DelayMs(uint16_t n)
{
  uint16_t i,j;
  for(i=0;i<n;i++)
    for(j=0;j<7400;j++);
}

/*****************************************************************************
初始化T5L必须配置的寄存器*/
//void InitCFG(void)
//{
//  CKCON      = 0x00;
//  T2CON      = 0x70;
//  DPC        = 0x00;
//  PAGESEL    = 0x01;
//  D_PAGESEL  = 0x02;
//  MUX_SEL    = 0x60;
//  PORTDRV    = 0x01;
//  RAMMODE    = 0x00;
//}

/*****************************************************************************
中断配置*/
void InitInt(void)
{
  IEN0       = 0x00;                     /*关闭所有中断*/
  IEN1       = 0x00;
  IEN2       = 0x00;
  IP0        = 0x00;                     /*中断优先级默认*/
  IP1        = 0x00;
}
/*****************************************************************************
GPIO输出*/
void InitGPIO(void)
{
  PORTDRV    = 0x01;
  P0MDOUT    = 0xc3;                     /*开启P0_0和P0_1的输出*/
  P1MDOUT    = 0xa3;                     /*开启P1_0和P1_1 1_7 P1_5的输出*/
 // P1MDOUT    = 0x83;                     /*开启P1_0和P1_1 1_7 的输出*/
  P2MDOUT    = 0x2A;										/*开启P2_1 P2_3*/
  P3MDOUT    = 0x0C;
  P0         = 0x00;
  P1         = 0x00;
  P2         = 0x00;
  P3         = 0x00;
}
void EX0_ISR_PC(void)    interrupt 0
{
    EA=0;

    EA=1;
}
void EX1_ISR_PC(void)    interrupt 2
{
    EA=0;

    EA=1;
}


void sys_read_vp(u16 addr,u8* buf,u16 len)
{   
	u8 i; 
	
	i = (u8)(addr&0x01);
	addr >>= 1;
	ADR_H = 0x00;
	ADR_M = (u8)(addr>>8);
	ADR_L = (u8)addr;
	ADR_INC = 0x01;
	RAMMODE = 0xAF;
	while(APP_ACK==0);
	while(len>0)
	{   
		APP_EN=1;
		while(APP_EN==1);
		if((i==0)&&(len>0))   
		{   
			*buf++ = DATA3;
			*buf++ = DATA2;                      
			i = 1;
			len--;	
		}
		if((i==1)&&(len>0))   
		{   
			*buf++ = DATA1;
			*buf++ = DATA0;                      
			i = 0;
			len--;	
		}
	}
	RAMMODE = 0x00;
}
/*****************************************************************************
初始化T5L ASIC*/
void InitCPU(void)
{
  EA=0;
//  InitCFG();      /*改为在A51启动文件初始化*/
  InitInt();
  InitGPIO();
  InitUart();
  InitTimer();
//  WDT_ON();
  EA=1;
}
